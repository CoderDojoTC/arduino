/*
 * PIR Interrupt test
 * 
 */

#define PIR_PIN A0
#define PWM_OUT_PIN 3

#define STATUS_LED 12

int intensity[256] = {
0x00, 0x00, 0x00, 0x00, 0x00, 0x00, 0x00, 0x00, 0x00, 0x00, 0x01, 0x01, 0x01, 0x01, 0x01, 0x01,
0x01, 0x01, 0x01, 0x01, 0x01, 0x01, 0x01, 0x01, 0x01, 0x02, 0x02, 0x02, 0x02, 0x02, 0x02, 0x02,
0x02, 0x02, 0x03, 0x03, 0x03, 0x03, 0x03, 0x03, 0x04, 0x04, 0x04, 0x04, 0x04, 0x05, 0x05, 0x05,
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0xFD, 0xFD, 0xFD, 0xFD, 0xFD, 0xFD, 0xFD, 0xFE, 0xFE, 0xFE, 0xFE, 0xFE, 0xFE, 0xFE, 0xFF, 0xFF};

// 1 for on, 0 for off
int pir_state = 0;
int pir_last_state = 0;
int led_strip_state = 1; // turn the LED on on power up

unsigned long lastChangeTime = 0;  // the last time the output pin was toggled
unsigned long deltaTime = 0;  // time difference between now and last change
unsigned long debounceDelay = 15000;    // 10 seconds

void setup() {
  pinMode(PIR_PIN, INPUT);
  pinMode(PWM_OUT_PIN, OUTPUT);
  pinMode(STATUS_LED, OUTPUT);
 
  analogWrite(PWM_OUT_PIN, 0); // make sure the LED is off to start
  led_strip_state = 0;
  lastChangeTime = millis();
  Serial.begin(9600);
  // flash on for 1 second
  digitalWrite(STATUS_LED, HIGH);
  analogWrite(PWM_OUT_PIN, 255);
  delay(1000);
  analogWrite(PWM_OUT_PIN, 0);
  digitalWrite(STATUS_LED, LOW);
}

void loop() {

  // get the new state of the PIR sensor
  pir_state = digitalRead(PIR_PIN);
  
  Serial.print("pir_state=");
  Serial.print(pir_state);
  Serial.print(" led_state=");
  Serial.print(led_strip_state);
  // we calculate the milliseconds since our last change
  deltaTime = millis() - lastChangeTime;
  Serial.print(" deltaTime=");
  Serial.println(deltaTime);
  
  
  if (pir_state == 1 && led_strip_state == 0)
      turn_on();
      else if (pir_state == 0 && led_strip_state == 1) turn_off();

  delay(200);
}

void turn_on() {
  if (deltaTime > debounceDelay) {
    Serial.println("Light Turning On...");
    for (int i=0; i<=255; i++) {
      analogWrite(PWM_OUT_PIN, intensity[i]);
      delay(20); // 1/50th of a second for 5 second ramp up
    }
    digitalWrite(STATUS_LED, HIGH);
    led_strip_state = 1;
    lastChangeTime =  millis();
  }
}

void turn_off() {
  if (deltaTime > debounceDelay) {
    Serial.println("Light Turning Off...");
    for (int i=255; i>=0; i--) {
      analogWrite(PWM_OUT_PIN, i);
      delay(20); // 1/50th of a second for 5 second ramp up
    }
    digitalWrite(STATUS_LED, LOW);
    led_strip_state = 0;
    lastChangeTime =  millis();
  }
}
